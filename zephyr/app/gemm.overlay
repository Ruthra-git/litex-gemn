/ {
    soc {
        gemm0: gemm@90000000 {
            compatible = "litex,gemm-accel";
            reg = <0x90000000 0x100>;

            interrupt-parent = <&intc0>;
            interrupts = <2 0>;

            status = "okay";
        };
    };
};
